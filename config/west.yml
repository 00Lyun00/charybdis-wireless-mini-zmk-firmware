## config/west.yml
```yaml
manifest:
  remotes:
    - name: zmkfirmware
      url-base: https://github.com/zmkfirmware
    - name: 280Zo
      url-base: https://github.com/280Zo
    - name: m165437
      url-base: https://github.com/M165437

  projects:
    - name: zmk
      remote: zmkfirmware
      revision: main
      import: app/west.yml
    - name: zmk-pmw3610-driver
      remote: 280Zo
      revision: main
    - name: prospector-zmk-module
      remote: 280Zo
      revision: main
    - name: nice-view-gem
      remote: m165437
      revision: main
      .

  self:
    path: config
```
